## modules/base/Kconfig
```kconfig
# Vendor Kconfig symbols of the FP6 boot base layer that 6.18 Kconfig lacks. Types as in
# KERNEL.PLATFORM.5.0 or our 6.1 tree, values in defconfig.

config ARCH_CLIFFS
	bool "ARCH_CLIFFS"

config ARCH_FPSPRING
	bool "ARCH_FPSPRING"

config ARCH_PINEAPPLE
	bool "ARCH_PINEAPPLE"

config ARCH_VOLCANO
	bool "ARCH_VOLCANO"

config CPU_IDLE_GOV_QCOM_LPM
	tristate "CPU_IDLE_GOV_QCOM_LPM"

config FP6_SDHCI_MSM
	tristate "FP6_SDHCI_MSM"

config GH_ARM64_DRV
	tristate "GH_ARM64_DRV"

config GH_CPUSYS_VM_MEM_ACCESS
	tristate "GH_CPUSYS_VM_MEM_ACCESS"

config GH_DBL
	tristate "GH_DBL"

config GH_IRQ_LEND
	tristate "GH_IRQ_LEND"

config GH_MEM_NOTIFIER
	tristate "GH_MEM_NOTIFIER"

config GH_MSGQ
	tristate "GH_MSGQ"

config GH_RM_DRV
	tristate "GH_RM_DRV"

config GUNYAH_DRIVERS
	bool "GUNYAH_DRIVERS"

config INTERCONNECT_QCOM_DEBUG
	tristate "INTERCONNECT_QCOM_DEBUG"

config INTERCONNECT_QCOM_QOS
	tristate "INTERCONNECT_QCOM_QOS"

config INTERCONNECT_QCOM_VOLCANO
	tristate "INTERCONNECT_QCOM_VOLCANO"

config IOMMU_IO_PGTABLE_FAST
	bool "IOMMU_IO_PGTABLE_FAST"

config IPC_LOGGING
	tristate "IPC_LOGGING"

config IPC_LOGGING_CDEV
	tristate "IPC_LOGGING_CDEV"

config IPC_LOG_MINIDUMP_BUFFERS
	int "IPC_LOG_MINIDUMP_BUFFERS"

config MINIDUMP_MAX_ENTRIES
	int "MINIDUMP_MAX_ENTRIES"

config MSM_QMP
	tristate "MSM_QMP"

config MSM_TMECOM_QMP
	tristate "MSM_TMECOM_QMP"

config PDR_INDICATION_NOTIF_TIMEOUT
	int "PDR_INDICATION_NOTIF_TIMEOUT"

config PHY_QCOM_UFS
	tristate "PHY_QCOM_UFS"

config PHY_QCOM_UFS_V4_CROW
	tristate "PHY_QCOM_UFS_V4_CROW"

config PINCTRL_VOLCANO
	tristate "PINCTRL_VOLCANO"

config POWER_RESET_QCOM_DOWNLOAD_MODE
	tristate "POWER_RESET_QCOM_DOWNLOAD_MODE"

config POWER_RESET_QCOM_DOWNLOAD_MODE_DEFAULT
	bool "POWER_RESET_QCOM_DOWNLOAD_MODE_DEFAULT"

config POWER_RESET_QCOM_REBOOT_REASON
	tristate "POWER_RESET_QCOM_REBOOT_REASON"

config QCOM_CPUSS_SLEEP_STATS
	tristate "QCOM_CPUSS_SLEEP_STATS"

config QCOM_DCC_V2
	tristate "QCOM_DCC_V2"

config QCOM_DEBUG_SYMBOL
	tristate "QCOM_DEBUG_SYMBOL"

config QCOM_DMABUF_HEAPS
	tristate "QCOM_DMABUF_HEAPS"

config QCOM_DMABUF_HEAPS_CARVEOUT
	bool "QCOM_DMABUF_HEAPS_CARVEOUT"

config QCOM_DMABUF_HEAPS_CMA
	bool "QCOM_DMABUF_HEAPS_CMA"

config QCOM_DMABUF_HEAPS_DEFERRED_FREE
	tristate "QCOM_DMABUF_HEAPS_DEFERRED_FREE"

config QCOM_DMABUF_HEAPS_PAGE_POOL_REFILL
	bool "QCOM_DMABUF_HEAPS_PAGE_POOL_REFILL"

config QCOM_DMABUF_HEAPS_SYSTEM
	bool "QCOM_DMABUF_HEAPS_SYSTEM"

config QCOM_DMABUF_HEAPS_SYSTEM_SECURE
	bool "QCOM_DMABUF_HEAPS_SYSTEM_SECURE"

config QCOM_GDSC_REGULATOR
	tristate "QCOM_GDSC_REGULATOR"

config QCOM_GLINK
	tristate "QCOM_GLINK"

config QCOM_IOMMU_DEBUG
	tristate "QCOM_IOMMU_DEBUG"

config QCOM_IOMMU_UTIL
	tristate "QCOM_IOMMU_UTIL"

config QCOM_LAZY_MAPPING
	tristate "QCOM_LAZY_MAPPING"

config QCOM_MEMORY_DUMP_V2
	tristate "QCOM_MEMORY_DUMP_V2"

config QCOM_MEM_BUF
	tristate "QCOM_MEM_BUF"

config QCOM_MEM_BUF_DEV
	tristate "QCOM_MEM_BUF_DEV"

config QCOM_MEM_BUF_DEV_GH
	bool "QCOM_MEM_BUF_DEV_GH"

config QCOM_MEM_BUF_GH
	bool "QCOM_MEM_BUF_GH"

config QCOM_MINIDUMP
	tristate "QCOM_MINIDUMP"

config QCOM_MINIDUMP_FTRACE
	bool "QCOM_MINIDUMP_FTRACE"

config QCOM_MINIDUMP_PANIC_CPU_CONTEXT
	bool "QCOM_MINIDUMP_PANIC_CPU_CONTEXT"

config QCOM_MINIDUMP_PANIC_DUMP
	bool "QCOM_MINIDUMP_PANIC_DUMP"

config QCOM_MINIDUMP_PANIC_MEMORY_INFO
	bool "QCOM_MINIDUMP_PANIC_MEMORY_INFO"

config QCOM_MINIDUMP_PSTORE
	bool "QCOM_MINIDUMP_PSTORE"

config QCOM_MINIDUMP_RM
	bool "QCOM_MINIDUMP_RM"

config QCOM_MINIDUMP_SMEM
	bool "QCOM_MINIDUMP_SMEM"

config QCOM_PANEL_EVENT_NOTIFIER
	tristate "QCOM_PANEL_EVENT_NOTIFIER"

config QCOM_PANIC_ON_NOTIF_TIMEOUT
	bool "QCOM_PANIC_ON_NOTIF_TIMEOUT"

config QCOM_PANIC_ON_PDR_NOTIF_TIMEOUT
	bool "QCOM_PANIC_ON_PDR_NOTIF_TIMEOUT"

config QCOM_RAMDUMP
	tristate "QCOM_RAMDUMP"

config QCOM_RPMH_TIMEOUT
	int "QCOM_RPMH_TIMEOUT"

config QCOM_RPROC_BOTH_DUMPS
	bool "QCOM_RPROC_BOTH_DUMPS"

config QCOM_SDEI
	tristate "QCOM_SDEI"

config QCOM_SECURE_BUFFER
	tristate "QCOM_SECURE_BUFFER"

config QCOM_SHOW_RESUME_IRQ
	tristate "QCOM_SHOW_RESUME_IRQ"

config QCOM_SMCINVOKE
	tristate "QCOM_SMCINVOKE"

config QCOM_SYSMON_SUBSYSTEM_STATS
	tristate "QCOM_SYSMON_SUBSYSTEM_STATS"

config QCOM_VA_MINIDUMP
	tristate "QCOM_VA_MINIDUMP"

config QCOM_WATCHDOG_BARK_TIME
	int "QCOM_WATCHDOG_BARK_TIME"

config QCOM_WATCHDOG_IPI_PING
	bool "QCOM_WATCHDOG_IPI_PING"

config QCOM_WATCHDOG_PET_TIME
	int "QCOM_WATCHDOG_PET_TIME"

config QCOM_WATCHDOG_WAKEUP_ENABLE
	bool "QCOM_WATCHDOG_WAKEUP_ENABLE"

config QCOM_WDT_CORE
	tristate "QCOM_WDT_CORE"

config QRTR_IMSDCM_OWNERSHIP
	bool "QRTR_IMSDCM_OWNERSHIP"

config QRTR_NODE_ID
	int "QRTR_NODE_ID"

config QRTR_WAKEUP_MS
	int "QRTR_WAKEUP_MS"

config QSEECOM_COMPAT
	bool "QSEECOM_COMPAT"

config QSEECOM_PROXY
	tristate "QSEECOM_PROXY"

config QTEE_SHM_BRIDGE
	bool "QTEE_SHM_BRIDGE"

config QTI_ALTMODE_GLINK
	tristate "QTI_ALTMODE_GLINK"

config QTI_BATTERY_CHARGER
	tristate "QTI_BATTERY_CHARGER"

config QTI_CRYPTO_COMMON
	tristate "QTI_CRYPTO_COMMON"

config QTI_HW_KEY_MANAGER
	tristate "QTI_HW_KEY_MANAGER"

config QTI_IOMMU_SUPPORT
	tristate "QTI_IOMMU_SUPPORT"

config QTI_PMIC_EUSB2_REPEATER
	tristate "QTI_PMIC_EUSB2_REPEATER"

config QTI_PMIC_GLINK
	tristate "QTI_PMIC_GLINK"

config QTI_PMIC_PON_LOG
	tristate "QTI_PMIC_PON_LOG"

config REGULATOR_DEBUG_CONTROL
	tristate "REGULATOR_DEBUG_CONTROL"

config REGULATOR_PROXY_CONSUMER
	tristate "REGULATOR_PROXY_CONSUMER"

config REGULATOR_QTI_FIXED_VOLTAGE
	tristate "REGULATOR_QTI_FIXED_VOLTAGE"

config REGULATOR_QTI_PM8008
	tristate "REGULATOR_QTI_PM8008"

config REGULATOR_RPMH
	tristate "REGULATOR_RPMH"

config REGULATOR_STUB
	tristate "REGULATOR_STUB"

config RPROC_SSR_NOTIF_TIMEOUT
	int "RPROC_SSR_NOTIF_TIMEOUT"

config RPROC_SYSMON_NOTIF_TIMEOUT
	int "RPROC_SYSMON_NOTIF_TIMEOUT"

config RPROC_SYSMON_SHUTDOWN_NOTIF_TIMEOUT
	int "RPROC_SYSMON_SHUTDOWN_NOTIF_TIMEOUT"

config SCSI_UFS_CRYPTO_QTI
	tristate "SCSI_UFS_CRYPTO_QTI"

config SM_CAMCC_VOLCANO
	tristate "SM_CAMCC_VOLCANO"

config SM_DEBUGCC_VOLCANO
	tristate "SM_DEBUGCC_VOLCANO"

config SM_DISPCC_VOLCANO
	tristate "SM_DISPCC_VOLCANO"

config SM_GCC_VOLCANO
	tristate "SM_GCC_VOLCANO"

config SM_GPUCC_VOLCANO
	tristate "SM_GPUCC_VOLCANO"

config SM_TCSRCC_PINEAPPLE
	tristate "SM_TCSRCC_PINEAPPLE"

config SM_VIDEOCC_VOLCANO
	tristate "SM_VIDEOCC_VOLCANO"

config SPMI_MSM_PMIC_ARB_DEBUG
	tristate "SPMI_MSM_PMIC_ARB_DEBUG"

config UCSI_QTI_GLINK
	tristate "UCSI_QTI_GLINK"

config USB_DWC3_MSM
	tristate "USB_DWC3_MSM"

config USB_MSM_EUSB2_PHY
	tristate "USB_MSM_EUSB2_PHY"

config USB_MSM_SSPHY_QMP
	tristate "USB_MSM_SSPHY_QMP"

config USB_REPEATER
	tristate "USB_REPEATER"

config FP6_BASE_SELECTS
	tristate "FP6 base layer: the 6.18 symbols that are select-only"
	select INTERCONNECT_QCOM_BCM_VOTER
	select INTERCONNECT_QCOM_RPMH
	select QCOM_PDR_HELPERS
```

## modules/base/defconfig
```kconfig
# Vendor Kconfig values of the FP6 boot base layer (fp6/base.list), for ddk_config and build/kbuild.py.
# Generated from modules.bzl, the 6.1 vendor configuration, the 5.0 settings and the vendor policy.
CONFIG_ARCH_CLIFFS=y
CONFIG_ARCH_FPSPRING=y
CONFIG_ARCH_PINEAPPLE=y
CONFIG_ARCH_VOLCANO=y
CONFIG_ARM_SMMU=m
CONFIG_ARM_SMMU_DISABLE_BYPASS_BY_DEFAULT=y
CONFIG_ARM_SMMU_QCOM=m
CONFIG_COMMON_CLK_QCOM=m
CONFIG_CPU_IDLE_GOV_QCOM_LPM=m
CONFIG_FP6_BASE_SELECTS=m
CONFIG_FP6_SDHCI_MSM=m
CONFIG_GH_ARM64_DRV=m
CONFIG_GH_CPUSYS_VM_MEM_ACCESS=m
CONFIG_GH_DBL=m
CONFIG_GH_VIRT_WATCHDOG=m
CONFIG_GH_IRQ_LEND=m
CONFIG_GH_MEM_NOTIFIER=m
CONFIG_GH_MSGQ=m
CONFIG_GH_RM_DRV=m
CONFIG_GUNYAH_DRIVERS=y
CONFIG_HWSPINLOCK_QCOM=m
CONFIG_INPUT_PM8941_PWRKEY=m
CONFIG_INTERCONNECT_QCOM_BCM_VOTER=m
CONFIG_INTERCONNECT_QCOM_DEBUG=m
CONFIG_INTERCONNECT_QCOM_QOS=m
CONFIG_INTERCONNECT_QCOM_RPMH=m
CONFIG_INTERCONNECT_QCOM_RPMH_POSSIBLE=m
CONFIG_INTERCONNECT_QCOM_VOLCANO=m
CONFIG_IOMMU_IO_PGTABLE_FAST=y
CONFIG_IPC_LOGGING=m
# CONFIG_IPC_LOGGING_CDEV is not set
CONFIG_IPC_LOG_MINIDUMP_BUFFERS=16
CONFIG_MFD_SPMI_PMIC=m
CONFIG_MINIDUMP_MAX_ENTRIES=200
CONFIG_MSM_QMP=m
CONFIG_MSM_TMECOM_QMP=m
CONFIG_NVMEM_QCOM_QFPROM=m
CONFIG_NVMEM_SPMI_SDAM=m
CONFIG_PDR_INDICATION_NOTIF_TIMEOUT=9000
CONFIG_PHY_QCOM_UFS=m
CONFIG_PHY_QCOM_UFS_V4_CROW=m
CONFIG_PINCTRL_MSM=m
CONFIG_PINCTRL_QCOM_SPMI_PMIC=m
CONFIG_PINCTRL_VOLCANO=m
CONFIG_POWER_RESET_QCOM_DOWNLOAD_MODE=m
# CONFIG_POWER_RESET_QCOM_DOWNLOAD_MODE_DEFAULT is not set
CONFIG_POWER_RESET_QCOM_PON=m
CONFIG_POWER_RESET_QCOM_REBOOT_REASON=m
CONFIG_QCOM_AOSS_QMP=m
CONFIG_QCOM_CLK_RPMH=m
CONFIG_QCOM_COMMAND_DB=m
CONFIG_QCOM_CPUSS_SLEEP_STATS=m
CONFIG_QCOM_DCC_V2=m
CONFIG_QCOM_DEBUG_SYMBOL=m
CONFIG_QCOM_DMABUF_HEAPS=m
CONFIG_QCOM_DMABUF_HEAPS_CARVEOUT=y
CONFIG_QCOM_DMABUF_HEAPS_CMA=y
CONFIG_QCOM_DMABUF_HEAPS_DEFERRED_FREE=m
CONFIG_QCOM_DMABUF_HEAPS_PAGE_POOL_REFILL=y
CONFIG_QCOM_DMABUF_HEAPS_SYSTEM=y
CONFIG_QCOM_DMABUF_HEAPS_SYSTEM_SECURE=y
CONFIG_QCOM_GDSC_REGULATOR=m
CONFIG_QCOM_GLINK=m
CONFIG_QCOM_IOMMU_DEBUG=m
CONFIG_QCOM_IOMMU_UTIL=m
CONFIG_QCOM_IPCC=m
CONFIG_QCOM_LAZY_MAPPING=m
CONFIG_QCOM_LLCC=m
CONFIG_QCOM_MDT_LOADER=m
CONFIG_QCOM_MEMORY_DUMP_V2=m
CONFIG_QCOM_MEM_BUF=m
CONFIG_QCOM_MEM_BUF_DEV=m
# CONFIG_QCOM_MEM_BUF_DEV_GH is not set
# CONFIG_QCOM_MEM_BUF_GH is not set
CONFIG_QCOM_MINIDUMP=m
CONFIG_QCOM_MINIDUMP_FTRACE=y
CONFIG_QCOM_MINIDUMP_PANIC_CPU_CONTEXT=y
CONFIG_QCOM_MINIDUMP_PANIC_DUMP=y
# CONFIG_QCOM_MINIDUMP_PANIC_MEMORY_INFO is not set
CONFIG_QCOM_MINIDUMP_PSTORE=y
# CONFIG_QCOM_MINIDUMP_RM is not set
CONFIG_QCOM_MINIDUMP_SMEM=y
CONFIG_QCOM_PANEL_EVENT_NOTIFIER=m
CONFIG_QCOM_PANIC_ON_NOTIF_TIMEOUT=y
CONFIG_QCOM_PANIC_ON_PDR_NOTIF_TIMEOUT=y
CONFIG_QCOM_PDC=m
CONFIG_QCOM_PDR_HELPERS=m
CONFIG_QCOM_PDR_MSG=m
CONFIG_QCOM_PIL_INFO=m
CONFIG_QCOM_Q6V5_COMMON=m
CONFIG_QCOM_Q6V5_PAS=m
CONFIG_QCOM_QMI_HELPERS=m
CONFIG_QCOM_RAMDUMP=m
CONFIG_QCOM_RPMH=m
CONFIG_QCOM_RPMH_TIMEOUT=5000
CONFIG_QCOM_RPROC_BOTH_DUMPS=y
CONFIG_QCOM_RPROC_COMMON=m
CONFIG_QCOM_SCM=m
CONFIG_QCOM_SDEI=m
CONFIG_QCOM_SECURE_BUFFER=m
CONFIG_QCOM_SHOW_RESUME_IRQ=m
CONFIG_QCOM_SMCINVOKE=m
CONFIG_QCOM_SMEM=m
CONFIG_QCOM_SMP2P=m
CONFIG_QCOM_SOCINFO=m
CONFIG_QCOM_STATS=m
CONFIG_QCOM_SYSMON=m
CONFIG_QCOM_SYSMON_SUBSYSTEM_STATS=m
CONFIG_QCOM_TZMEM=m
CONFIG_QCOM_TZMEM_MODE_SHMBRIDGE=y
CONFIG_QCOM_VA_MINIDUMP=m
CONFIG_QCOM_WATCHDOG_BARK_TIME=11000
CONFIG_QCOM_WATCHDOG_IPI_PING=y
CONFIG_QCOM_WATCHDOG_PET_TIME=9360
CONFIG_QCOM_WATCHDOG_WAKEUP_ENABLE=y
CONFIG_QCOM_WDT_CORE=m
CONFIG_QRTR=m
CONFIG_QRTR_IMSDCM_OWNERSHIP=y
CONFIG_QRTR_NODE_ID=1
CONFIG_QRTR_SMD=m
# CONFIG_QRTR_TUN is not set
CONFIG_QRTR_WAKEUP_MS=0
CONFIG_QSEECOM_COMPAT=y
CONFIG_QSEECOM_PROXY=m
CONFIG_QTEE_SHM_BRIDGE=y
CONFIG_QTI_ALTMODE_GLINK=m
CONFIG_QTI_BATTERY_CHARGER=m
CONFIG_QTI_CRYPTO_COMMON=m
CONFIG_QTI_HW_KEY_MANAGER=m
CONFIG_QTI_IOMMU_SUPPORT=m
CONFIG_QTI_PMIC_EUSB2_REPEATER=m
CONFIG_QTI_PMIC_GLINK=m
CONFIG_QTI_PMIC_PON_LOG=m
CONFIG_REBOOT_MODE=m
CONFIG_REGULATOR_DEBUG_CONTROL=m
CONFIG_REGULATOR_PROXY_CONSUMER=m
CONFIG_REGULATOR_QTI_FIXED_VOLTAGE=m
CONFIG_REGULATOR_QTI_PM8008=m
CONFIG_REGULATOR_RPMH=m
CONFIG_REGULATOR_STUB=m
CONFIG_RPMSG_QCOM_GLINK=m
CONFIG_RPMSG_QCOM_GLINK_SMEM=m
CONFIG_RPROC_SSR_NOTIF_TIMEOUT=20000
CONFIG_RPROC_SYSMON_NOTIF_TIMEOUT=20000
CONFIG_RPROC_SYSMON_SHUTDOWN_NOTIF_TIMEOUT=10000
CONFIG_RTC_DRV_PM8XXX=m
CONFIG_SCSI_UFS_CRYPTO_QTI=m
CONFIG_SCSI_UFS_QCOM=m
CONFIG_SM_CAMCC_VOLCANO=m
CONFIG_SM_DEBUGCC_VOLCANO=m
CONFIG_SM_DISPCC_VOLCANO=m
CONFIG_SM_GCC_VOLCANO=m
CONFIG_SM_GPUCC_VOLCANO=m
CONFIG_SM_TCSRCC_PINEAPPLE=m
CONFIG_SM_VIDEOCC_VOLCANO=m
CONFIG_SPMI_MSM_PMIC_ARB=m
CONFIG_SPMI_MSM_PMIC_ARB_DEBUG=m
CONFIG_UCSI_QTI_GLINK=m
CONFIG_USB_DWC3_MSM=m
CONFIG_USB_MSM_EUSB2_PHY=m
CONFIG_USB_MSM_SSPHY_QMP=m
CONFIG_USB_REPEATER=m
```

## modules/display/Kconfig
```kconfig
config EMKIT_INFO
	tristate "Fairphone board information (EMKIT)"

config BACKLIGHT_QCOM_SPMI_WLED
	tristate "Qualcomm PMIC WLED backlight"

config REGULATOR_QPNP_LCDB
	tristate "Qualcomm PMIC LCD bias (LCDB) regulator"
```

## modules/display/defconfig
```kconfig
CONFIG_EMKIT_INFO=m
CONFIG_BACKLIGHT_QCOM_SPMI_WLED=m
CONFIG_REGULATOR_QPNP_LCDB=m
```

## modules/peripherals/Kconfig
```kconfig
# Vendor Kconfig symbols of modules/peripherals that 6.18 Kconfig and modules/base lack. Types as in
# KERNEL.PLATFORM.5.0 or our 6.1 tree, values in defconfig.

config AWINIC_HAPTIC_HV
	tristate "AWINIC_HAPTIC_HV"

config FINGER_FOCAL
	tristate "FINGER_FOCAL"

config HALL_DET
	tristate "HALL_DET"

config I2C_MSM_GENI
	tristate "I2C_MSM_GENI"

config INPUT_QCOM_HV_HAPTICS
	tristate "INPUT_QCOM_HV_HAPTICS"

config LEDS_QPNP_VIBRATOR_LDO
	tristate "LEDS_QPNP_VIBRATOR_LDO"

config MFD_I2C_PMIC
	tristate "MFD_I2C_PMIC"

config MSM_GPI_DMA
	tristate "MSM_GPI_DMA"

config PWM_QTI_LPG
	tristate "PWM_QTI_LPG"

config QCOM_SPMI_ADC5_GEN3
	tristate "QCOM_SPMI_ADC5_GEN3"

config QTI_CHARGER_ULOG_GLINK
	tristate "QTI_CHARGER_ULOG_GLINK"

config QTI_GLINK_ADC
	tristate "QTI_GLINK_ADC"

config REGULATOR_QTI_OCP_NOTIFIER
	tristate "REGULATOR_QTI_OCP_NOTIFIER"

config SERIAL_MSM_GENI
	tristate "SERIAL_MSM_GENI"

config SPI_MSM_GENI
	tristate "SPI_MSM_GENI"

config FP6_PERIPHERALS_SELECTS
	tristate "modules/peripherals: the 6.18 symbols that are select-only"
	select QCOM_VADC_COMMON
```

## modules/thermal-dcvs/Kconfig
```kconfig
# Vendor Kconfig symbols of modules/thermal-dcvs that 6.18 Kconfig and modules/base lack. Types as in
# KERNEL.PLATFORM.5.0 or our 6.1 tree, values in defconfig.

config MSM_PERFORMANCE
	tristate "MSM_PERFORMANCE"

config MSM_SYSSTATS
	tristate "MSM_SYSSTATS"

config MSM_SYSSTATS_STUB_NONEXPORTED_SYMBOLS
	bool "MSM_SYSSTATS_STUB_NONEXPORTED_SYMBOLS"

config QCOM_BWMON
	tristate "QCOM_BWMON"

config QCOM_BWPROF
	tristate "QCOM_BWPROF"

config QCOM_CPUCP
	tristate "QCOM_CPUCP"

config QCOM_CPU_PHYS_LOG_MAP
	tristate "QCOM_CPU_PHYS_LOG_MAP"

config QCOM_DCVS
	tristate "QCOM_DCVS"

config QCOM_DCVS_FP
	tristate "QCOM_DCVS_FP"

config QCOM_LLCC_PERFMON
	tristate "QCOM_LLCC_PERFMON"

config QCOM_LLCC_PMU
	tristate "QCOM_LLCC_PMU"

config QCOM_MEMLAT
	tristate "QCOM_MEMLAT"

config QCOM_PMU_LIB
	tristate "QCOM_PMU_LIB"

config QTI_BCL_PMIC5
	tristate "QTI_BCL_PMIC5"

config QTI_BCL_SOC_DRIVER
	tristate "QTI_BCL_SOC_DRIVER"

config QTI_C1DCVS_SCMI_V2
	tristate "QTI_C1DCVS_SCMI_V2"

config QTI_CPUCP_LOG
	tristate "QTI_CPUCP_LOG"

config QTI_CPUFREQ_CDEV
	tristate "QTI_CPUFREQ_CDEV"

config QTI_CPUFREQ_STATS_SCMI_V2
	tristate "QTI_CPUFREQ_STATS_SCMI_V2"

config QTI_CPU_HOTPLUG_COOLING_DEVICE
	tristate "QTI_CPU_HOTPLUG_COOLING_DEVICE"

config QTI_CPU_VOLTAGE_COOLING_DEVICE
	tristate "QTI_CPU_VOLTAGE_COOLING_DEVICE"

config QTI_DDR_COOLING_DEVICE
	tristate "QTI_DDR_COOLING_DEVICE"

config QTI_DEVFREQ_CDEV
	tristate "QTI_DEVFREQ_CDEV"

config QTI_DYNPF_SCMI
	tristate "QTI_DYNPF_SCMI"

config QTI_MPAM
	tristate "QTI_MPAM"

config QTI_PLH
	bool "QTI_PLH"

config QTI_QCOM_SCMI_CLIENT
	tristate "QTI_QCOM_SCMI_CLIENT"

config QTI_QMI_COOLING_DEVICE
	tristate "QTI_QMI_COOLING_DEVICE"

config QTI_QMI_SENSOR_V2
	tristate "QTI_QMI_SENSOR_V2"

config QTI_SCMI_VENDOR_PROTOCOL
	tristate "QTI_SCMI_VENDOR_PROTOCOL"

config QTI_SYS_PM_VX
	tristate "QTI_SYS_PM_VX"

config QTI_THERMALZONE_CONFIG_DEBUG
	tristate "QTI_THERMALZONE_CONFIG_DEBUG"

config QTI_THERMAL_LIMITS_DCVS
	tristate "QTI_THERMAL_LIMITS_DCVS"

config QTI_THERMAL_MINIDUMP
	tristate "QTI_THERMAL_MINIDUMP"

config QTI_THERMAL_VENDOR_HOOK
	tristate "QTI_THERMAL_VENDOR_HOOK"

config QTI_USERSPACE_CDEV
	tristate "QTI_USERSPACE_CDEV"
```
